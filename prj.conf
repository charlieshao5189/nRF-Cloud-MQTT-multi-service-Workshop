## Kconfig
```
#
# Copyright (c) 2022 Nordic Semiconductor ASA
#
# SPDX-License-Identifier: LicenseRef-Nordic-5-Clause
#

menu "MQTT Multi Service Sample Settings"

config POWER_SAVING_MODE_ENABLE
	bool "Enable Power Saving Mode (PSM)"
	help
	  Enable to request Power Saving Mode from cellular network.

config LTE_INIT_RETRY_TIMEOUT_SECONDS
	int "LTE initialization retry timeout (seconds)"
	default 30
	help
	  Sets the number of seconds between each LTE modem initialization
	  retry.

config CLOUD_CONNECTION_RETRY_TIMEOUT_SECONDS
	int "Cloud connection retry timeout (seconds)"
	default 30
	help
	  If connecting to nRF Cloud takes longer than this timeout, it will be
	  reattempted.

config CLOUD_CONNECTION_REESTABLISH_DELAY_SECONDS
	int "Cloud connection reestablishment delay (seconds)"
	default 5
	help
	  After the connection to nRF Cloud has been reset, wait this amount of
	  time before attempting to connect again.

config CLOUD_READY_TIMEOUT_SECONDS
	int "Cloud readiness timeout (seconds)"
	default 600
	help
	  If the connection to nRF Cloud does not become ready within this
	  timeout, the sample will reset its connection and try again.

config DATE_TIME_ESTABLISHMENT_TIMEOUT_SECONDS
	int "Modem date and time establishment timeout (seconds)"
	default 300
	help
	  The sample will wait this many seconds for the modem to determine the
	  current date and time before giving up and moving on.

config APPLICATION_THREAD_STACK_SIZE
	int "Application Thread Stack Size (bytes)"
	default 2048
	help
	  Sets the stack size (in bytes) for the application thread of the
	  sample.

config CONNECTION_THREAD_STACK_SIZE
	int "Connection Thread Stack Size (bytes)"
	default 2048
	help
	  Sets the stack size (in bytes) for the connection thread of the
	  sample.

config MESSAGE_THREAD_STACK_SIZE
	int "Message Queue Thread Stack Size (bytes)"
	default 2048
	help
	  Sets the stack size (in bytes) for the message queue processing
	  thread of the sample.

config MAX_OUTGOING_MESSAGES
	int "Outgoing message maximum"
	default 64
	help
	  Sets the maximum number of device messages which may be enqueued
	  before further messages are dropped.

config MAX_CONSECUTIVE_SEND_FAILURES
	int "Max outgoing consecutive send failures"
	default 5
	help
	  Sets the maximum number of device messages which may fail to send
	  before a connection reset and cooldown is triggered.

config CONSECUTIVE_SEND_FAILURE_COOLDOWN_SECONDS
	int "Cooldown after max consecutive send failures exceeded"
	default 10
	help
	  If a connection reset is triggered by too many failed device
	  messages, the sample will wait this long (in seconds) before trying
	  again.

config SENSOR_SAMPLE_INTERVAL_SECONDS
	int "Sensor sampling interval (seconds)"
	default 60
	help
	  Sets the time to wait between each sensor sample.

config LOCATION_TRACKING_SAMPLE_INTERVAL_SECONDS
	int "Location sampling interval (seconds)"
	default 60
	help
	  Sets the location sampling interval in seconds.

config LOCATION_TRACKING_GNSS
	bool "Use GNSS method for location tracking"
	default y
	depends on LOCATION_METHOD_GNSS
	help
	  Disable both this and LOCATION_TRACKING_CELLULAR to completely disable location tracking.

config LOCATION_TRACKING_CELLULAR
	bool "Use cellular method for location tracking"
	default y
	depends on LOCATION_METHOD_CELLULAR
	help
	  Disable both this and LOCATION_TRACKING_GNSS to completely disable location tracking.

config TEMP_DATA_USE_SENSOR
	bool "Use genuine temperature data"
	depends on BOARD_THINGY91_NRF9160_NS
	default y if BOARD_THINGY91_NRF9160_NS
	select SENSOR
	select BME680
	help
	  Sets whether to take genuine temperature measurements from a
	  connected BME680 sensor, or just simulate sensor data.

config TEMP_TRACKING
	bool "Track temperature"
	default y
	help
	  Sets whether to take temperature measurements.

choice GNSS_ANTENNA
	default GNSS_ANTENNA_ONBOARD
	prompt "Select which antenna to use for GNSS"

config GNSS_ANTENNA_ONBOARD
	bool "Use onboard antenna"

config GNSS_ANTENNA_EXTERNAL
	bool "Use external antenna"

endchoice

config GNSS_AT_MAGPIO
	string "AT%XMAGPIO command"
	default "AT\%XMAGPIO=1,0,0,1,1,1574,1577" if BOARD_NRF9160DK_NRF9160_NS
	default "AT\%XMAGPIO=1,1,1,7,1,746,803,2,698,748,2,1710,2200,3,824,894,4,880,960,5,791,849,7,1565,1586" if BOARD_THINGY91_NRF9160_NS
	help
	  AT%XMAGPIO command to be sent to GNSS module.

config GNSS_AT_COEX0
	string "AT%XCOEX0 command"
	default "AT\%XCOEX0=1,1,1565,1586" if (BOARD_NRF9160DK_NRF9160_NS || BOARD_THINGY91_NRF9160_NS) && GNSS_ANTENNA_ONBOARD
	default "AT\%XCOEX0" if (BOARD_NRF9160DK_NRF9160_NS || BOARD_THINGY91_NRF9160_NS) && GNSS_ANTENNA_EXTERNAL
	help
	  AT%XCOEX0 command to be sent to GNSS module.

config GNSS_FIX_TIMEOUT_SECONDS
	int "GNSS Fix timeout"
	default 40
	help
	  On each location sample, try for this long to achieve a GNSS fix
	  before falling back to cellular positioning.
	  Set this to 20 or so seconds below the sensor sample interval so
	  that there is time left over to perform cellular positioning.
	  Otherwise, location samples may occur at a longer interval than
	  requested.

config TEST_COUNTER
	bool "Sets whether the test counter is enabled"

endmenu

config CLOUD_PUBLICATION_BUTTON_PRESS
	bool "Triggers publication to cloud upon a button press"
        default y
	help
	  press button to publish temperature message to nRF cloud.

module = MQTT_MULTI_SERVICE
module-str = MQTT Multi Service
source "${ZEPHYR_BASE}/subsys/logging/Kconfig.template.log_config"

menu "Zephyr Kernel"
source "Kconfig.zephyr"
endmenu
```

## prj.conf
```kconfig
#
# Copyright (c) 2022 Nordic Semiconductor ASA
#
# SPDX-License-Identifier: LicenseRef-Nordic-5-Clause
#

# Log level
# For more verbose and detailed log output, set the log level to
# CONFIG_MQTT_MULTI_SERVICE_LOG_LEVEL_DBG=y instead.
CONFIG_MQTT_MULTI_SERVICE_LOG_LEVEL_INF=y

# General config
CONFIG_EVENTS=y
CONFIG_NEWLIB_LIBC=y
CONFIG_NEWLIB_LIBC_FLOAT_PRINTF=y
CONFIG_RESET_ON_FATAL_ERROR=y
CONFIG_NCS_SAMPLES_DEFAULTS=y

# Heap and stacks
# Extended memory heap size needed both for PGPS and for encoding JSON-based nRF Cloud Device Messages
CONFIG_HEAP_MEM_POOL_SIZE=24576
CONFIG_SYSTEM_WORKQUEUE_STACK_SIZE=2048

# Network
CONFIG_NETWORKING=y
CONFIG_NET_NATIVE=n
CONFIG_NET_SOCKETS=y
CONFIG_NET_SOCKETS_OFFLOAD=y

# Modem library
CONFIG_NRF_MODEM_LIB=y

# AT commands interface
CONFIG_UART_INTERRUPT_DRIVEN=y
CONFIG_AT_HOST_LIBRARY=y

# nRF Cloud
CONFIG_NRF_CLOUD_MQTT=y # This also enables FOTA by implicitly setting CONFIG_NRF_CLOUD_FOTA=y

# MQTT
CONFIG_MQTT_KEEPALIVE=120

# MCUBOOT - Needed by FOTA
CONFIG_BOOTLOADER_MCUBOOT=y
CONFIG_IMG_MANAGER=y
CONFIG_MCUBOOT_IMG_MANAGER=y
CONFIG_STREAM_FLASH_ERASE=y

# Location Services configuration
CONFIG_LOCATION=y
CONFIG_LOCATION_METHOD_GNSS=y
CONFIG_LOCATION_METHOD_CELLULAR=y
CONFIG_NRF_CLOUD_AGPS=n
CONFIG_NRF_CLOUD_CELL_POS=y
CONFIG_MULTICELL_LOCATION_SERVICE_NRF_CLOUD=y
CONFIG_MODEM_INFO=y
CONFIG_MODEM_INFO_ADD_NETWORK=y
CONFIG_NRF_CLOUD_PGPS=n
CONFIG_NRF_CLOUD_PGPS_REPLACEMENT_THRESHOLD=4
CONFIG_NRF_CLOUD_PGPS_REQUEST_UPON_INIT=y

# Date Time lib - Used by PGPS and main application
CONFIG_DATE_TIME=y

# LTE link control - used by PGPS and main application
CONFIG_LTE_LINK_CONTROL=y
CONFIG_LTE_NETWORK_MODE_LTE_M_GPS=y
CONFIG_LTE_AUTO_INIT_AND_CONNECT=n

# Settings - used by nRF Cloud library and PGPS
CONFIG_SETTINGS=y
CONFIG_SETTINGS_FCB=y
CONFIG_FCB=y

# Download Client - used by FOTA and PGPS
CONFIG_DOWNLOAD_CLIENT=y
CONFIG_DOWNLOAD_CLIENT_HTTP_FRAG_SIZE_1024=y
CONFIG_DOWNLOAD_CLIENT_STACK_SIZE=4096
CONFIG_DOWNLOAD_CLIENT_BUF_SIZE=2300
CONFIG_DOWNLOAD_CLIENT_MAX_HOSTNAME_SIZE=128

# Flash - Used by FOTA and PGPS
CONFIG_FLASH=y
CONFIG_FLASH_PAGE_LAYOUT=y
CONFIG_FLASH_MAP=y
CONFIG_STREAM_FLASH=y
CONFIG_MPU_ALLOW_FLASH_WRITE=y
CONFIG_DK_LIBRARY=y

CONFIG_SENSOR_SAMPLE_INTERVAL_SECONDS=180
CONFIG_LOCATION_TRACKING_SAMPLE_INTERVAL_SECONDS=300

CONFIG_CAF=y
CONFIG_CAF_LEDS=y
CONFIG_PWM=y
CONFIG_LED=y
CONFIG_LED_PWM=y 
```

## src/main.c
```c
/* Copyright (c) 2022 Nordic Semiconductor ASA
 *
 * SPDX-License-Identifier: LicenseRef-Nordic-5-Clause
 */

#include <zephyr/kernel.h>
#include <stdio.h>
#include <zephyr/logging/log.h>
#include "application.h"
#include "connection.h"
#include "fota_support.h"
#include <app_event_manager.h>

LOG_MODULE_REGISTER(main, CONFIG_MQTT_MULTI_SERVICE_LOG_LEVEL);
#define MODULE main
#include <caf/events/module_state_event.h>

static void msg_thread_fn(void)
{
	/* Continuously consume (that is, send to NRF Cloud) queued-up outgoing messages. */
	while (true) {
		(void)consume_device_message();
	}
}

static void app_thread_fn(void)
{
	/* Wait for first connection before starting the application. */
	(void)await_connection(K_FOREVER);

	/* Afterwards, allow application to run in this thread. */
	main_application();
}

static void conn_thread_fn(void)
{
	/* Continuously manage our connection. */
	manage_connection();
}


K_THREAD_DEFINE(app_thread, CONFIG_APPLICATION_THREAD_STACK_SIZE, app_thread_fn,
		NULL, NULL, NULL, 0, 0, 0);

K_THREAD_DEFINE(msg_thread, CONFIG_MESSAGE_THREAD_STACK_SIZE, msg_thread_fn,
		NULL, NULL, NULL, 0, 0, 0);

/* The connection thread is given higher priority (-1) so that it can preempt the other threads,
 * for instance in the event of a call to disconnect_cloud().
 *
 * Priority -1 is also a non-preeemptible priority level, so other threads, even of higher
 * priority, cannot interrupt the connection thread until it yields.
 */
K_THREAD_DEFINE(conn_thread, CONFIG_CONNECTION_THREAD_STACK_SIZE, conn_thread_fn,
		NULL, NULL, NULL, -1, 0, 0);


void main(void)
{
	LOG_INF("nRF Cloud MQTT multi-service sample has started.");
        app_event_manager_init();
        module_set_state(MODULE_STATE_READY);
}
```

## src/application.c
```c
/* Copyright (c) 2022 Nordic Semiconductor ASA
 *
 * SPDX-License-Identifier: LicenseRef-Nordic-5-Clause
 */

#include <zephyr/kernel.h>
#include <zephyr/logging/log.h>
#include <modem/location.h>
#include <net/nrf_cloud.h>
#include "nrf_cloud_codec.h"
#include <stdio.h>
#include <date_time.h>
#include <cJSON.h>
#include <math.h>

#include "application.h"
#include "temperature.h"
#include "connection.h"

#include "location_tracking.h"

#include <dk_buttons_and_leds.h>

LOG_MODULE_REGISTER(application, CONFIG_MQTT_MULTI_SERVICE_LOG_LEVEL);

/* Timer used to time the sensor sampling rate. */
static K_TIMER_DEFINE(sensor_sample_timer, NULL, NULL);

struct k_work_delayable cloud_update_work;

/**
 * @brief Construct a data device message cJSON object with automatically generated timestamp.
 *
 * @param appid
 * @return cJSON* - the timestamped data device message object if successful, NULL otherwise.
 */
static cJSON *create_timestamped_data_message_object(const char *const appid)
{
	cJSON *msg_obj = NULL;
	int64_t timestamp;

	if (date_time_now(&timestamp)) {
		LOG_ERR("Failed to create timestamp for data message "
			"with appid %s", log_strdup(appid));
		return NULL;
	}

	msg_obj = cJSON_CreateObject();
	if (msg_obj == NULL) {
		LOG_ERR("Failed to create container object for timestamped data message "
			"with appid %s", log_strdup(appid));
		return NULL;
	}

	/* This structure corresponds to the General Message Schema described in the
	 * application-protocols repo:
	 * https://github.com/nRFCloud/application-protocols
	 */

	if ((cJSON_AddStringToObject(msg_obj, NRF_CLOUD_JSON_APPID_KEY, appid)  == NULL) ||
	    (cJSON_AddStringToObject(msg_obj, NRF_CLOUD_JSON_MSG_TYPE_KEY,
					      NRF_CLOUD_JSON_MSG_TYPE_VAL_DATA) == NULL) ||
	    (cJSON_AddNumberToObject(msg_obj, NRF_CLOUD_MSG_TIMESTAMP_KEY,
					      (double)timestamp)		== NULL)) {
		LOG_ERR("Failed to populate timestamped data message object "
			"with appid %s", log_strdup(appid));
		cJSON_Delete(msg_obj);
		return NULL;
	}

	return msg_obj;
}

/**
 * @brief Transmit a collected sensor sample to nRF Cloud.
 *
 * @param sensor - The name of the sensor which was sampled.
 * @param value - The sampled sensor value.
 * @return int - 0 on success, negative error code otherwise.
 */
static int send_sensor_sample(const char *const sensor, double value)
{
	int ret = 0;

	/* Create a timestamped message container object for the sensor sample. */
	cJSON *msg_obj = create_timestamped_data_message_object(sensor);

	if (msg_obj == NULL) {
		ret = -EINVAL;
		goto cleanup;
	}

	/* Populate the container object with the sensor value. */
	if (cJSON_AddNumberToObject(msg_obj, NRF_CLOUD_JSON_DATA_KEY, value) == NULL) {
		ret = -ENOMEM;
		LOG_ERR("Failed to append value to %s sample container object ",
			log_strdup(sensor));
		goto cleanup;
	}

	/* Send the sensor sample container object as a device message. */
	ret = send_device_message_cJSON(msg_obj);

cleanup:
	if (msg_obj) {
		cJSON_Delete(msg_obj);
	}
	return ret;
}

/**
 * @brief Transmit a collected GNSS sample to nRF Cloud.
 *
 * @param NMEA - The raw MNEA value to send to nRF Cloud.
 * @return int - 0 on success, negative error code otherwise.
 */
static int send_gnss_nmea(const char *const nmea)
{
	int ret = 0;

	/* Create a timestamped message container object for the GNSS NMEA data. */
	cJSON *msg_obj = create_timestamped_data_message_object(NRF_CLOUD_JSON_APPID_VAL_GPS);

	if (!msg_obj) {
		ret = -EINVAL;
		goto cleanup;
	}

	/* Populate the container object with the NMEA data. */
	if (cJSON_AddStringToObject(msg_obj, NRF_CLOUD_JSON_DATA_KEY, nmea) == NULL) {
		ret = -ENOMEM;
		LOG_ERR("Failed to append NMEA data to GNSS message object");
		goto cleanup;
	}

	/* Send the sensor sample container object as a device message. */
	ret = send_device_message_cJSON(msg_obj);

cleanup:
	if (msg_obj) {
		cJSON_Delete(msg_obj);
	}
	return ret;
}


/**
 * @brief Compute checksum for NMEA string.
 *
 * @param datastring - The NMEA string to compute the checksum for.
 * @return uint8_t - The resultant checksum.
 */
static uint8_t nmea_checksum(const char *const datastring)
{
	uint8_t checksum = 0;
	int len = strlen(datastring);

	for (int i = 0; i < len; i++) {
		checksum ^= datastring[i];
	}
	return checksum;
}

/**
 * @brief Callback to receive periodic location updates from location_tracking.c and forward them
 * to nRF Cloud.
 *
 * Note that cellular positioning (MCELL/Multi-Cell and SCELL/Single-Cell) is sent to nRF
 * Cloud automatically (since the Location library and nRF Cloud must work together to
 * determine them in the first place). GNSS positions, on the other hand, must be
 * sent manually, since they are determined entirely on-device.
 *
 * @param location_data - The received location update.
 *
 */
static void on_location_update(const struct location_data location_data)
{
	LOG_INF("Location Updated: %.06f N %.06f W, accuracy: %.01f m, Method: %s",
		location_data.latitude, location_data.longitude, location_data.accuracy,
		location_data.method == LOCATION_METHOD_CELLULAR	? "Cellular" :
		location_data.method == LOCATION_METHOD_GNSS		? "GNSS"     :
		location_data.method == LOCATION_METHOD_WIFI		? "WIFI"     :
									  "Invalid");

	/* If the position update was derived using GNSS, send it onward to nRF Cloud. */
	if (location_data.method == LOCATION_METHOD_GNSS) {
		LOG_INF("GNSS Position Update! Sending to nRF Cloud...");

		/* Synthesize an NMEA message from the provided lat/long/timestamp.
		 * This is necessary, because the nRF Cloud MQTT API only supports NMEA messages.
		 */

		char nmea_buf[50];
		int lat_deg = floor(fabs(location_data.latitude));
		int lon_deg = floor(fabs(location_data.longitude));
		double lat_min = (fabs(location_data.latitude) - lat_deg) * 60;
		double lon_min = (fabs(location_data.longitude) - lon_deg) * 60;

		/* Not actually a valid NMEA,
		 * but close enough that nRF Cloud can't tell the difference.
		 */
		snprintf(nmea_buf, sizeof(nmea_buf), "$GPGGA,,%02d%08.5f,%c,%02d%08.5f,%c,,,,,,,,,",
			lat_deg, lat_min, location_data.latitude > 0 ? 'N':'S',
			lon_deg, lon_min, location_data.longitude > 0 ? 'E':'W');

		int payload_length = strlen(nmea_buf);

		snprintf(nmea_buf + payload_length, sizeof(nmea_buf) - payload_length, "*%02X\n",
			 nmea_checksum(nmea_buf + 1));
		LOG_DBG("NMEA: %s", log_strdup(nmea_buf));

		/* Send the NMEA string. */
		send_gnss_nmea(nmea_buf);
	}
}


static void cloud_update_work_fn(struct k_work *work)
{
	if (IS_ENABLED(CONFIG_TEMP_TRACKING)) {
		double temp = -1;
		if (get_temperature(&temp) == 0) {
			LOG_INF("Temperature is %d degrees C", (int)temp);
			(void)send_sensor_sample(NRF_CLOUD_JSON_APPID_VAL_TEMP, temp);
		}
	}
}
static void work_init(void)
{
	k_work_init_delayable(&cloud_update_work, cloud_update_work_fn);
}

#if defined(CONFIG_CLOUD_PUBLICATION_BUTTON_PRESS)
static void button_handler(uint32_t button_states, uint32_t has_changed)
{

	if (has_changed & button_states & DK_BTN1_MSK) {
                LOG_INF("Button is pressed! Collect and send temperature to nRF Cloud.");
		k_work_reschedule(&cloud_update_work, K_NO_WAIT);
	}
}
#endif

void main_application(void)
{
	/* Wait for the date and time to become known.
	 * This is needed both for location services and for sensor sample timestamping.
	 */
	LOG_INF("Waiting for modem to determine current date and time");
	if (!await_date_time_known(K_SECONDS(CONFIG_DATE_TIME_ESTABLISHMENT_TIMEOUT_SECONDS))) {
		LOG_WRN("Failed to determine valid date time. Proceeding anyways");
	} else {
		LOG_INF("Current date and time determined");
		LOG_INF("Welcome to this Workshop! See this message on nRF Cloud Terminal");
		send_sensor_sample("Welcome to this Workshop!",0);
	}

        work_init();
        LOG_INF("Button is initialized!");
        #if defined(CONFIG_CLOUD_PUBLICATION_BUTTON_PRESS)
                int err;
		err = dk_buttons_init(button_handler);
		if (err) {
			LOG_ERR("dk_buttons_init, error: %d", err);
		}
	#endif

	/* Begin tracking location at the configured interval. */
	(void)start_location_tracking(on_location_update,
					CONFIG_LOCATION_TRACKING_SAMPLE_INTERVAL_SECONDS);

	int counter = 0;

	/* Begin sampling sensors. */
	while (true) {
		/* Start the sensor sample interval timer.
		 * We use a timer here instead of merely sleeping the thread, because the
		 * application thread can be preempted by other threads performing long tasks
		 * (such as periodic location acquisition), and we want to account for these
		 * delays when metering the sample send rate.
		 */
		k_timer_start(&sensor_sample_timer,
			K_SECONDS(CONFIG_SENSOR_SAMPLE_INTERVAL_SECONDS), K_FOREVER);

		if (IS_ENABLED(CONFIG_TEMP_TRACKING)) {
			double temp = -1;

			if (get_temperature(&temp) == 0) {
				LOG_INF("Temperature is %d degrees C", (int)temp);
				(void)send_sensor_sample(NRF_CLOUD_JSON_APPID_VAL_TEMP, temp);
			}
		}

		if (IS_ENABLED(CONFIG_TEST_COUNTER)) {
			(void)send_sensor_sample("COUNT", counter++);
		}

		/* Wait out any remaining time on the sample interval timer. */
		k_timer_status_sync(&sensor_sample_timer);
	}
}
```
